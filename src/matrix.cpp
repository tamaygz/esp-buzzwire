#include "matrix.h"
#include "config.h"
#include <FastLED.h>

// ── Matrix LED Array ────────────────────────────────────────────────────────
static CRGB matrixLeds[MATRIX_NUM_LEDS];
static CLEDController* gMatrixCtrl = nullptr;

// ── Font Character Width ─────────────────────────────────────────────────────
// Every glyph in font8x8_basic occupies exactly 8 columns.
static constexpr int FONT_CHAR_WIDTH = 8;

// ── Scroll State (non-blocking) ─────────────────────────────────────────────
static int           scrollOffset = 0;
static unsigned long lastScroll   = 0;
static const char*   scrollPtr    = nullptr;    // Pointer sentinel for change detection
static int           scrollLen    = 0;
static bool          scrollDirty  = true;       // Set by matrixScrollReset() or new content

// ── font8x8_basic — Full printable ASCII 0x20–0x7E in PROGMEM ──────────────
// Each character is 8 bytes; each byte is one row (LSB = left pixel).
static const uint8_t PROGMEM font8x8_basic[][8] = {
    // 0x20  ' '
    { 0x00, 0x00, 0x00, 0x00, 0x00, 0x00, 0x00, 0x00 },
    // 0x21  '!'
    { 0x18, 0x3C, 0x3C, 0x18, 0x18, 0x00, 0x18, 0x00 },
    // 0x22  '"'
    { 0x36, 0x36, 0x14, 0x00, 0x00, 0x00, 0x00, 0x00 },
    // 0x23  '#'
    { 0x36, 0x36, 0x7F, 0x36, 0x7F, 0x36, 0x36, 0x00 },
    // 0x24  '$'
    { 0x0C, 0x3E, 0x03, 0x1E, 0x30, 0x1F, 0x0C, 0x00 },
    // 0x25  '%'
    { 0x00, 0x63, 0x33, 0x18, 0x0C, 0x66, 0x63, 0x00 },
    // 0x26  '&'
    { 0x1C, 0x36, 0x1C, 0x6E, 0x3B, 0x33, 0x6E, 0x00 },
    // 0x27  '''
    { 0x06, 0x06, 0x03, 0x00, 0x00, 0x00, 0x00, 0x00 },
    // 0x28  '('
    { 0x18, 0x0C, 0x06, 0x06, 0x06, 0x0C, 0x18, 0x00 },
    // 0x29  ')'
    { 0x06, 0x0C, 0x18, 0x18, 0x18, 0x0C, 0x06, 0x00 },
    // 0x2A  '*'
    { 0x00, 0x66, 0x3C, 0xFF, 0x3C, 0x66, 0x00, 0x00 },
    // 0x2B  '+'
    { 0x00, 0x0C, 0x0C, 0x3F, 0x0C, 0x0C, 0x00, 0x00 },
    // 0x2C  ','
    { 0x00, 0x00, 0x00, 0x00, 0x00, 0x0C, 0x0C, 0x06 },
    // 0x2D  '-'
    { 0x00, 0x00, 0x00, 0x3F, 0x00, 0x00, 0x00, 0x00 },
    // 0x2E  '.'
    { 0x00, 0x00, 0x00, 0x00, 0x00, 0x0C, 0x0C, 0x00 },
    // 0x2F  '/'
    { 0x60, 0x30, 0x18, 0x0C, 0x06, 0x03, 0x01, 0x00 },
    // 0x30  '0'
    { 0x3E, 0x63, 0x73, 0x7B, 0x6F, 0x67, 0x3E, 0x00 },
    // 0x31  '1'
    { 0x0C, 0x0E, 0x0C, 0x0C, 0x0C, 0x0C, 0x3F, 0x00 },
    // 0x32  '2'
    { 0x1E, 0x33, 0x30, 0x1C, 0x06, 0x33, 0x3F, 0x00 },
    // 0x33  '3'
    { 0x1E, 0x33, 0x30, 0x1C, 0x30, 0x33, 0x1E, 0x00 },
    // 0x34  '4'
    { 0x38, 0x3C, 0x36, 0x33, 0x7F, 0x30, 0x30, 0x00 },
    // 0x35  '5'
    { 0x3F, 0x03, 0x1F, 0x30, 0x30, 0x33, 0x1E, 0x00 },
    // 0x36  '6'
    { 0x1C, 0x06, 0x03, 0x1F, 0x33, 0x33, 0x1E, 0x00 },
    // 0x37  '7'
    { 0x3F, 0x33, 0x30, 0x18, 0x0C, 0x0C, 0x0C, 0x00 },
    // 0x38  '8'
    { 0x1E, 0x33, 0x33, 0x1E, 0x33, 0x33, 0x1E, 0x00 },
    // 0x39  '9'
    { 0x1E, 0x33, 0x33, 0x3E, 0x30, 0x18, 0x0E, 0x00 },
    // 0x3A  ':'
    { 0x00, 0x0C, 0x0C, 0x00, 0x00, 0x0C, 0x0C, 0x00 },
    // 0x3B  ';'
    { 0x00, 0x0C, 0x0C, 0x00, 0x00, 0x0C, 0x0C, 0x06 },
    // 0x3C  '<'
    { 0x18, 0x0C, 0x06, 0x03, 0x06, 0x0C, 0x18, 0x00 },
    // 0x3D  '='
    { 0x00, 0x00, 0x3F, 0x00, 0x00, 0x3F, 0x00, 0x00 },
    // 0x3E  '>'
    { 0x06, 0x0C, 0x18, 0x30, 0x18, 0x0C, 0x06, 0x00 },
    // 0x3F  '?'
    { 0x1E, 0x33, 0x30, 0x18, 0x0C, 0x00, 0x0C, 0x00 },
    // 0x40  '@'
    { 0x3E, 0x63, 0x7B, 0x7B, 0x7B, 0x03, 0x1E, 0x00 },
    // 0x41  'A'
    { 0x0C, 0x1E, 0x33, 0x33, 0x3F, 0x33, 0x33, 0x00 },
    // 0x42  'B'
    { 0x3F, 0x66, 0x66, 0x3E, 0x66, 0x66, 0x3F, 0x00 },
    // 0x43  'C'
    { 0x3C, 0x66, 0x03, 0x03, 0x03, 0x66, 0x3C, 0x00 },
    // 0x44  'D'
    { 0x1F, 0x36, 0x66, 0x66, 0x66, 0x36, 0x1F, 0x00 },
    // 0x45  'E'
    { 0x7F, 0x46, 0x16, 0x1E, 0x16, 0x46, 0x7F, 0x00 },
    // 0x46  'F'
    { 0x7F, 0x46, 0x16, 0x1E, 0x16, 0x06, 0x0F, 0x00 },
    // 0x47  'G'
    { 0x3C, 0x66, 0x03, 0x03, 0x73, 0x66, 0x7C, 0x00 },
    // 0x48  'H'
    { 0x33, 0x33, 0x33, 0x3F, 0x33, 0x33, 0x33, 0x00 },
    // 0x49  'I'
    { 0x1E, 0x0C, 0x0C, 0x0C, 0x0C, 0x0C, 0x1E, 0x00 },
    // 0x4A  'J'
    { 0x78, 0x30, 0x30, 0x30, 0x33, 0x33, 0x1E, 0x00 },
    // 0x4B  'K'
    { 0x67, 0x66, 0x36, 0x1E, 0x36, 0x66, 0x67, 0x00 },
    // 0x4C  'L'
    { 0x0F, 0x06, 0x06, 0x06, 0x46, 0x66, 0x7F, 0x00 },
    // 0x4D  'M'
    { 0x63, 0x77, 0x7F, 0x7F, 0x6B, 0x63, 0x63, 0x00 },
    // 0x4E  'N'
    { 0x63, 0x67, 0x6F, 0x7B, 0x73, 0x63, 0x63, 0x00 },
    // 0x4F  'O'
    { 0x1C, 0x36, 0x63, 0x63, 0x63, 0x36, 0x1C, 0x00 },
    // 0x50  'P'
    { 0x3F, 0x66, 0x66, 0x3E, 0x06, 0x06, 0x0F, 0x00 },
    // 0x51  'Q'
    { 0x1E, 0x33, 0x33, 0x33, 0x3B, 0x1E, 0x38, 0x00 },
    // 0x52  'R'
    { 0x3F, 0x66, 0x66, 0x3E, 0x36, 0x66, 0x67, 0x00 },
    // 0x53  'S'
    { 0x1E, 0x33, 0x07, 0x0E, 0x38, 0x33, 0x1E, 0x00 },
    // 0x54  'T'
    { 0x3F, 0x2D, 0x0C, 0x0C, 0x0C, 0x0C, 0x1E, 0x00 },
    // 0x55  'U'
    { 0x33, 0x33, 0x33, 0x33, 0x33, 0x33, 0x3F, 0x00 },
    // 0x56  'V'
    { 0x33, 0x33, 0x33, 0x33, 0x33, 0x1E, 0x0C, 0x00 },
    // 0x57  'W'
    { 0x63, 0x63, 0x63, 0x6B, 0x7F, 0x77, 0x63, 0x00 },
    // 0x58  'X'
    { 0x63, 0x63, 0x36, 0x1C, 0x1C, 0x36, 0x63, 0x00 },
    // 0x59  'Y'
    { 0x33, 0x33, 0x33, 0x1E, 0x0C, 0x0C, 0x1E, 0x00 },
    // 0x5A  'Z'
    { 0x7F, 0x63, 0x31, 0x18, 0x4C, 0x66, 0x7F, 0x00 },
    // 0x5B  '['
    { 0x1E, 0x06, 0x06, 0x06, 0x06, 0x06, 0x1E, 0x00 },
    // 0x5C  '\'
    { 0x03, 0x06, 0x0C, 0x18, 0x30, 0x60, 0x40, 0x00 },
    // 0x5D  ']'
    { 0x1E, 0x18, 0x18, 0x18, 0x18, 0x18, 0x1E, 0x00 },
    // 0x5E  '^'
    { 0x08, 0x1C, 0x36, 0x63, 0x00, 0x00, 0x00, 0x00 },
    // 0x5F  '_'
    { 0x00, 0x00, 0x00, 0x00, 0x00, 0x00, 0x00, 0xFF },
    // 0x60  '`'
    { 0x0C, 0x0C, 0x18, 0x00, 0x00, 0x00, 0x00, 0x00 },
    // 0x61  'a'
    { 0x00, 0x00, 0x1E, 0x30, 0x3E, 0x33, 0x6E, 0x00 },
    // 0x62  'b'
    { 0x07, 0x06, 0x06, 0x3E, 0x66, 0x66, 0x3B, 0x00 },
    // 0x63  'c'
    { 0x00, 0x00, 0x1E, 0x33, 0x03, 0x33, 0x1E, 0x00 },
    // 0x64  'd'
    { 0x38, 0x30, 0x30, 0x3E, 0x33, 0x33, 0x6E, 0x00 },
    // 0x65  'e'
    { 0x00, 0x00, 0x1E, 0x33, 0x3F, 0x03, 0x1E, 0x00 },
    // 0x66  'f'
    { 0x1C, 0x36, 0x06, 0x0F, 0x06, 0x06, 0x0F, 0x00 },
    // 0x67  'g'
    { 0x00, 0x00, 0x6E, 0x33, 0x33, 0x3E, 0x30, 0x1F },
    // 0x68  'h'
    { 0x07, 0x06, 0x36, 0x6E, 0x66, 0x66, 0x67, 0x00 },
    // 0x69  'i'
    { 0x0C, 0x00, 0x0E, 0x0C, 0x0C, 0x0C, 0x1E, 0x00 },
    // 0x6A  'j'
    { 0x30, 0x00, 0x30, 0x30, 0x30, 0x33, 0x33, 0x1E },
    // 0x6B  'k'
    { 0x07, 0x06, 0x66, 0x36, 0x1E, 0x36, 0x67, 0x00 },
    // 0x6C  'l'
    { 0x0E, 0x0C, 0x0C, 0x0C, 0x0C, 0x0C, 0x1E, 0x00 },
    // 0x6D  'm'
    { 0x00, 0x00, 0x33, 0x7F, 0x7F, 0x6B, 0x63, 0x00 },
    // 0x6E  'n'
    { 0x00, 0x00, 0x1F, 0x33, 0x33, 0x33, 0x33, 0x00 },
    // 0x6F  'o'
    { 0x00, 0x00, 0x1E, 0x33, 0x33, 0x33, 0x1E, 0x00 },
    // 0x70  'p'
    { 0x00, 0x00, 0x3B, 0x66, 0x66, 0x3E, 0x06, 0x0F },
    // 0x71  'q'
    { 0x00, 0x00, 0x6E, 0x33, 0x33, 0x3E, 0x30, 0x78 },
    // 0x72  'r'
    { 0x00, 0x00, 0x3B, 0x6E, 0x66, 0x06, 0x0F, 0x00 },
    // 0x73  's'
    { 0x00, 0x00, 0x3E, 0x03, 0x1E, 0x30, 0x1F, 0x00 },
    // 0x74  't'
    { 0x08, 0x0C, 0x3E, 0x0C, 0x0C, 0x2C, 0x18, 0x00 },
    // 0x75  'u'
    { 0x00, 0x00, 0x33, 0x33, 0x33, 0x33, 0x6E, 0x00 },
    // 0x76  'v'
    { 0x00, 0x00, 0x33, 0x33, 0x33, 0x1E, 0x0C, 0x00 },
    // 0x77  'w'
    { 0x00, 0x00, 0x63, 0x6B, 0x7F, 0x7F, 0x36, 0x00 },
    // 0x78  'x'
    { 0x00, 0x00, 0x63, 0x36, 0x1C, 0x36, 0x63, 0x00 },
    // 0x79  'y'
    { 0x00, 0x00, 0x33, 0x33, 0x33, 0x3E, 0x30, 0x1F },
    // 0x7A  'z'
    { 0x00, 0x00, 0x3F, 0x19, 0x0C, 0x26, 0x3F, 0x00 },
    // 0x7B  '{'
    { 0x38, 0x0C, 0x0C, 0x07, 0x0C, 0x0C, 0x38, 0x00 },
    // 0x7C  '|'
    { 0x18, 0x18, 0x18, 0x00, 0x18, 0x18, 0x18, 0x00 },
    // 0x7D  '}'
    { 0x07, 0x0C, 0x0C, 0x38, 0x0C, 0x0C, 0x07, 0x00 },
    // 0x7E  '~'
    { 0x6E, 0x3B, 0x00, 0x00, 0x00, 0x00, 0x00, 0x00 },
};

// ── XY Helper: Serpentine Layout ────────────────────────────────────────────
// Maps (x, y) grid coordinates to a linear LED index.
// Even rows run left→right; odd rows run right→left (MATRIX_SERPENTINE=1).
uint16_t XY(uint8_t x, uint8_t y) {
    if (x >= MATRIX_WIDTH || y >= MATRIX_HEIGHT) return 0;

#if MATRIX_SERPENTINE
    if (y & 1) {
        // Odd row: right-to-left
        return y * MATRIX_WIDTH + (MATRIX_WIDTH - 1 - x);
    }
#endif
    return y * MATRIX_WIDTH + x;
}

// ── Setup ───────────────────────────────────────────────────────────────────
void matrixSetup() {
    gMatrixCtrl = &FastLED.addLeds<WS2812B, MATRIX_PIN, GRB>(matrixLeds, MATRIX_NUM_LEDS);
    matrixClear();
    Serial.println(F("[MATRIX] Setup complete"));
}

// ── Clear ───────────────────────────────────────────────────────────────────
void matrixClear() {
    fill_solid(matrixLeds, MATRIX_NUM_LEDS, CRGB::Black);
    gMatrixCtrl->showLeds(MATRIX_BRIGHTNESS);
}

// ── Scroll Reset ─────────────────────────────────────────────────────────────
// Forces the next matrixScrollText() call to restart from the right edge.
// Call this whenever entering a new game state to avoid carrying over stale
// scroll position from a previous animation.
void matrixScrollReset() {
    scrollDirty  = true;
    scrollPtr    = nullptr;
    scrollOffset = MATRIX_WIDTH;
    DEBUG_LOGLN("[MATRIX] Scroll reset");
}

// ── Draw a Single Character at (x, y) ──────────────────────────────────────
// Clips pixels outside the 8×8 bounds; accepts x values down to −FONT_CHAR_WIDTH
// to support partial characters during scrolling.
void matrixDrawChar(int x, int y, char c, CRGB color) {
    if (c < 0x20 || c > 0x7E) c = ' ';
    uint8_t idx = (uint8_t)c - 0x20;

    for (int row = 0; row < FONT_CHAR_WIDTH; row++) {
        uint8_t rowData = pgm_read_byte(&font8x8_basic[idx][row]);
        for (int col = 0; col < FONT_CHAR_WIDTH; col++) {
            int px = x + col;
            int py = y + row;
            if (px >= 0 && px < MATRIX_WIDTH && py >= 0 && py < MATRIX_HEIGHT) {
                if (rowData & (1 << col)) {
                    matrixLeds[XY(px, py)] = color;
                }
            }
        }
    }
}

// ── Show a Single Large Character (fills full 8×8) ──────────────────────────
void matrixShowLetter(char c, CRGB color) {
    fill_solid(matrixLeds, MATRIX_NUM_LEDS, CRGB::Black);
    matrixDrawChar(0, 0, c, color);
    gMatrixCtrl->showLeds(MATRIX_BRIGHTNESS);
}

// ── Show a Number (1–2 digits, clamped to 0–99) ─────────────────────────────
void matrixShowNumber(int n, CRGB color) {
    fill_solid(matrixLeds, MATRIX_NUM_LEDS, CRGB::Black);

    if (n < 0)  n = 0;
    if (n > 99) n = 99;

    if (n < 10) {
        // Single digit — left-aligned (full 8×8 glyph)
        matrixDrawChar(0, 0, '0' + n, color);
    } else {
        // Two digits — tens at x=−1 (right half visible), ones at x=4
        matrixDrawChar(-1, 0, '0' + (n / 10), color);
        matrixDrawChar( 4, 0, '0' + (n % 10), color);
    }

    gMatrixCtrl->showLeds(MATRIX_BRIGHTNESS);
}

// ── Non-Blocking Scrolling Text ─────────────────────────────────────────────
// Call every loop tick. Advances one pixel column per delayMs milliseconds.
// Automatically loops. Call matrixScrollReset() first to restart from scratch.
void matrixScrollText(const char* text, CRGB color, int delayMs) {
    unsigned long now = millis();

    // Reset when the text pointer changes OR when an explicit reset was requested
    if (scrollDirty || text != scrollPtr) {
        scrollPtr    = text;
        scrollLen    = (int)strlen(text);
        scrollOffset = MATRIX_WIDTH;   // Start one full matrix-width off the right edge
        lastScroll   = now;
        scrollDirty  = false;
        DEBUG_LOG_VAL("[MATRIX] Scroll started: ", text);
    }

    if (now - lastScroll < (unsigned long)delayMs) return;
    lastScroll = now;

    fill_solid(matrixLeds, MATRIX_NUM_LEDS, CRGB::Black);

    // Render each visible character at its current horizontal position
    for (int i = 0; i < scrollLen; i++) {
        int charX = scrollOffset + i * FONT_CHAR_WIDTH;
        if (charX > -FONT_CHAR_WIDTH && charX < MATRIX_WIDTH) {
            matrixDrawChar(charX, 0, text[i], color);
        }
    }

    gMatrixCtrl->showLeds(MATRIX_BRIGHTNESS);

    scrollOffset--;
    // Wrap: restart from right edge once the last character exits the left
    if (scrollOffset < -(scrollLen * FONT_CHAR_WIDTH)) {
        scrollOffset = MATRIX_WIDTH;
    }
}
